## build_nrf9160_pca10090/Kconfig.modules
```kconfig
osource "C:/nRFsdk/ncs/nrf/Kconfig.nrf"

osource "C:/nRFsdk/ncs/mcuboot/zephyr/Kconfig"

osource "C:/nRFsdk/ncs/modules/lib/mcumgr/Kconfig"

osource "C:/nRFsdk/ncs/nrfxlib/Kconfig.nrfxlib"
```
