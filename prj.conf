## CMakeLists.txt
```
#
# Copyright (c) 2018 Nordic Semiconductor
#
# SPDX-License-Identifier: LicenseRef-BSD-5-Clause-Nordic
#

cmake_minimum_required(VERSION 3.8.2)

include(../../../cmake/boilerplate.cmake NO_POLICY_SCOPE)
include($ENV{ZEPHYR_BASE}/cmake/app/boilerplate.cmake NO_POLICY_SCOPE)
project(mqtt-simple)


# NORDIC SDK APP START
target_sources(app PRIVATE src/main.c)


# ELVA LIBRARIES START
zephyr_include_directories(src)

include_directories(src/LS013B7DH05_library)
target_sources(app PRIVATE src/LS013B7DH05_library/LS013B7DH05_library.c)

include_directories(src/MT15_library)
target_sources(app PRIVATE src/MT15_library/MT15_library.c)

include_directories(src/elva_initializer)
target_sources(app PRIVATE src/elva_initializer/elva_initializer.c)

include_directories(src/DRV2605L_library)
target_sources(app PRIVATE src/DRV2605L_library/DRV2605L_library.c)

include_directories(src/BQ27441_library)
target_sources(app PRIVATE src/BQ27441_library/BQ27441_library.c)

include_directories(src/medication_reminder)
target_sources(app PRIVATE src/medication_reminder/medication_reminder.c)

include_directories(src/ui_windows)
target_sources(app PRIVATE src/ui_windows/ui_windows.c)


# ELVA LIBRARIES END

# NORDIC SDK APP END
```

## Kconfig
```
#
# Copyright (c) 2018 Nordic Semiconductor ASA
#
# SPDX-License-Identifier: LicenseRef-BSD-5-Clause-Nordic
#

menu "MQTT simple sample"
config MQTT_PUB_TOPIC
	string "MQTT publish topic"
	#default "my/publish/topic"
	default "MyTopic"
	
config MQTT_SUB_TOPIC
	string "MQTT subscribe topic"
	#default "my/subscribe/topic"
	default "MyTopic"

config MQTT_CLIENT_ID
	string "MQTT Client ID"
	default "elva"

config MQTT_BROKER_HOSTNAME
	string "MQTT broker hostname"
	default "broker.hivemq.com"

config MQTT_BROKER_PORT
	int "MQTT broker port"
	default 8883

config MQTT_MESSAGE_BUFFER_SIZE
	int "MQTT message buffer size"
	default 128

config MQTT_PAYLOAD_BUFFER_SIZE
	default 128
	int "MQTT payload buffer size"
	
config MQTT_KEEPALIVE
    int "Maximum number of clients Keep alive time for MQTT (in seconds)"
    default 60

endmenu

menu "Zephyr Kernel"
source "$ZEPHYR_BASE/Kconfig.zephyr"
endmenu
```

## prj.conf
```kconfig
# General config
CONFIG_ASSERT=y
CONFIG_TEST_RANDOM_GENERATOR=y

# Networking
CONFIG_NETWORKING=y
CONFIG_NET_SOCKETS=y
CONFIG_NET_SOCKETS_OFFLOAD=y
CONFIG_NET_SOCKETS_POSIX_NAMES=y

# LTE link control
CONFIG_LTE_LINK_CONTROL=y
#CONFIG_LTE_AUTO_INIT_AND_CONNECT=n
CONFIG_LTE_AUTO_INIT_AND_CONNECT=y

# BSD library
CONFIG_BSD_LIBRARY=y

# AT Host Library
CONFIG_UART_INTERRUPT_DRIVEN=y
CONFIG_AT_HOST_LIBRARY=y

# MQTT
CONFIG_MQTT_LIB=y
CONFIG_MQTT_LIB_TLS=n

# Appliaction
CONFIG_MQTT_PUB_TOPIC="hbjg4153/outbox/device000"
CONFIG_MQTT_SUB_TOPIC="hbjg4153/inbox/device000"
CONFIG_MQTT_CLIENT_ID="device000"
CONFIG_MQTT_BROKER_HOSTNAME="broker.hivemq.com"
#CONFIG_MQTT_BROKER_HOSTNAME="mqtt.groov.com"
CONFIG_MQTT_BROKER_PORT=1883

# Main thread
CONFIG_MAIN_THREAD_PRIORITY=7
CONFIG_MAIN_STACK_SIZE=4096
CONFIG_HEAP_MEM_POOL_SIZE=1024

# Disable native network stack to save some memory
CONFIG_NET_IPV4=n
CONFIG_NET_IPV6=n
CONFIG_NET_UDP=n
CONFIG_NET_TCP=n

##Elva config
#CONFIG_SERIAL=y
#CONFIG_TRUSTED_EXECUTION_NONSECURE=y
#CONFIG_UART_INTERRUPT_DRIVEN=y
#CONFIG_UART_0_NRF_UARTE=y
CONFIG_UART_1_NRF_UARTE=y

# SPI master
CONFIG_SPI=y
CONFIG_SPI_3=y
CONFIG_SPI_3_NRF_SPIM=y
CONFIG_SPI_3=y 
CONFIG_SPI_NRFX=y

# Enable I2C master
CONFIG_I2C=y
CONFIG_I2C_2=y
CONFIG_I2C_NRFX=y
CONFIG_I2C_2_NRF_TWIM=y
CONFIG_I2C_INIT_PRIORITY=60
```

## prj_qemu_x86.conf
```kconfig
# General config
CONFIG_TEST_RANDOM_GENERATOR=y
CONFIG_NEWLIB_LIBC=y

# MQTT
CONFIG_MQTT_LIB=y
CONFIG_MQTT_LIB_TLS=n

# Networking config
CONFIG_NETWORKING=y
CONFIG_NET_IPV4=y
CONFIG_NET_TCP=y
CONFIG_NET_SOCKETS=y
CONFIG_NET_SOCKETS_POSIX_NAMES=y

CONFIG_DNS_RESOLVER=y
CONFIG_DNS_SERVER_IP_ADDRESSES=y
CONFIG_DNS_SERVER1="8.8.8.8"

# Network address config
CONFIG_NET_CONFIG_SETTINGS=y
CONFIG_NET_CONFIG_NEED_IPV4=y
CONFIG_NET_CONFIG_MY_IPV4_ADDR="192.0.2.1"
CONFIG_NET_CONFIG_PEER_IPV4_ADDR="192.0.2.2"
CONFIG_NET_CONFIG_MY_IPV4_GW="192.0.2.2"

# Appliaction
CONFIG_MQTT_PUB_TOPIC="hbjg4153/outbox/device000"
CONFIG_MQTT_SUB_TOPIC="hbjg4153/inbox/device000"
CONFIG_MQTT_CLIENT_ID="device000"
CONFIG_MQTT_BROKER_HOSTNAME="broker.hivemq.com" 
CONFIG_MQTT_BROKER_PORT=1883
#CONFIG_MQTT_PUB_TOPIC="/my/publish/topic"
#CONFIG_MQTT_SUB_TOPIC="/my/subscribe/topic"
#CONFIG_MQTT_CLIENT_ID="my-client-id"
#CONFIG_MQTT_BROKER_HOSTNAME="iot.eclipse.org" 
#CONFIG_MQTT_BROKER_PORT=1883

# Main thread
CONFIG_HEAP_MEM_POOL_SIZE=16384
CONFIG_MAIN_STACK_SIZE=16384
```

## src/certificates.h
```c
/*
 * Copyright (c) 2019 Nordic Semiconductor ASA
 *
 * SPDX-License-Identifier: LicenseRef-BSD-5-Clause-Nordic
 
/* #define CLOUD_CLIENT_PRIVATE_KEY \
 * 	"-----BEGIN RSA PRIVATE KEY-----\n" \
 * 	"AWS IoT client private key\n"\
 * 	"-----END RSA PRIVATE KEY-----\n"
 * 
 * #define CLOUD_CLIENT_PUBLIC_CERTIFICATE \
 * 	"-----BEGIN CERTIFICATE-----\n" \
 * 	"AWS IoT public certificate\n"\
 * 	"-----END CERTIFICATE-----\n"
 * 
 * #define CLOUD_CA_CERTIFICATE \
 * 	"-----BEGIN CERTIFICATE-----\n" \
 * 	"AWS IoT Root CA certificate\n"\
 * 	"-----END CERTIFICATE-----\n"
	*/

#define CLOUD_CLIENT_PRIVATE_KEY \
	"-----BEGIN RSA PRIVATE KEY-----\n"\
	"MIIEpAIBAAKCAQEArMI/zuLUQNTdw1j0rffJdqYlnj+ekKmwwl8RwPYRTB1MQ+y+\n"\
        "UFafqKIjtVERRUviOlFS51o1BZrbxJAg0TJaKEl8sOfOYn20nE436cur7PuqJFpG\n"\
        "vrD6nzh3w60WpaYL4C7GggKhYGaG3VyWkvYyjc9/HnTxhVUIgRERNLIkoBNG9Mre\n"\
        "h1WazKhYJaM9UhQ//BXjfS6vXIibQqWPnO3x0bYH36BmcQwXx4o7meKHRVpGhEur\n"\
        "K92es3dYxZpEDHiLFl4OmeFfsVFea2Q5lfIzTAFRxPtTPZVZTfhKH2yyOSabIclt\n"\
        "US2Aa7OAlijm+C4b5aX5l45IW4ZlnYUGUzysjwIDAQABAoIBADKar9AtN1lKQS9g\n"\
        "lkODSpsbrfc90Xe0jRdSe8PXEFgIWPeomFK2HQxreiQ5e+KdiMXmXm9wSAm9Q9S/\n"\
        "Fy3QHwKgDAtRy22kPsxuSQiN5W2EhmEhpIllE/ShuMszn2ekTOQ9L16T4Kt5PNYI\n"\
        "sf6YaVSKzESiosCYmOYdlrml2P6eS1d/uSxzO017WMRB7Gj2RIJruiwfvOp8P6l7\n"\
        "mYtLuvOCRf5Abyzqd/Un66M6kNoZeSSiW3daSeiJNWH0QPqINtmhfK0/zZPQ5LnS\n"\
        "IF2MXh2v+eISq8APfZ+ovZZfQoaSPXowR/Z+t1MRFzEqOuIfT/PqygCbURP59hDu\n"\
        "p5GbNLkCgYEA4+dt+R33PIdEbZgh1DamvKZ6+js1+76bD9tT5+KU6EauJAFTiI3B\n"\
        "R6q3ERmzvhGkA7R6pSLKWk+R1OvOSkANGaAPJ4IxIIbBwVVG2rb85enl+rglymEj\n"\
        "y+fZU+m7KP/s4l/eYPHjvLRJkWEfejR2Y4+E3Mcr7Jvk25qov5WiavsCgYEAwg50\n"\
        "nGJxMBS76c+uE0gsIvM9bAbbViVfoIfM8NWFj5nRGf1ki3T8hbuO1o1h0ctieKik\n"\
        "yeWGvCvYolVXR0e3ZYrXG0cMqdrLq0rbt8TnhJdTxJYrDpedw3IC4y24kK4nTgqx\n"\
        "WA2/ELRoZbqcr+4pY+FT71W/Wbe4+3GTJsyAUH0CgYEAlRxzcJ2xiHG8TLRP1egX\n"\
        "+bA3IAejj12rWJmY8UvnP34XK8mOXPbacch5VH/rgT1LgX0RDYCQwrvy30uVQjFc\n"\
        "INr/b0sYV36zwInJ/Qnit47sgLkBSMN7x0qff+6aHP4tgANXnThGV83hoHPaQ3uV\n"\
        "xhg9xrGtxHZPK3uqUwdVKAcCgYA7yrpxaP+ZIfpYa24mcMlwp2PYgjBY1cEmNFGY\n"\
        "LyItAebkzCeLtKsOBaFYSE3Il5MqvEOyFa+zEQt50TPIObevaN0ogXbMaybwC2ux\n"\
        "rtDrELl1zBNONrccfmeXWgIRSifAKxlDmVCys/OqzJn0tzw3kzkKeHAyE6LCjtcZ\n"\
        "UE+E/QKBgQDDSQvP/75Hy9foA7RkyhjziHcAWCvKyeqItum1xUMuwLW0ozfbC/RY\n"\
        "SMys5VUpSneYngyjlnw7AyftDcF3zLbyAGMfU2fPnngrrBBdC43/xVxIH3827nYW\n"\
        "Z4fA9lzq5L2fDzNkXb/HaokFkFO4BpMHQYL0wiM1kAd2idOcTlVgvg==\n"\
	"-----END RSA PRIVATE KEY-----\n"

#define CLOUD_CLIENT_PUBLIC_CERTIFICATE \
        "-----BEGIN PUBLIC KEY-----\n"\
        "MIIBIjANBgkqhkiG9w0BAQEFAAOCAQ8AMIIBCgKCAQEArMI/zuLUQNTdw1j0rffJ\n"\
        "dqYlnj+ekKmwwl8RwPYRTB1MQ+y+UFafqKIjtVERRUviOlFS51o1BZrbxJAg0TJa\n"\
        "KEl8sOfOYn20nE436cur7PuqJFpGvrD6nzh3w60WpaYL4C7GggKhYGaG3VyWkvYy\n"\
        "jc9/HnTxhVUIgRERNLIkoBNG9Mreh1WazKhYJaM9UhQ//BXjfS6vXIibQqWPnO3x\n"\
        "0bYH36BmcQwXx4o7meKHRVpGhEurK92es3dYxZpEDHiLFl4OmeFfsVFea2Q5lfIz\n"\
        "TAFRxPtTPZVZTfhKH2yyOSabIcltUS2Aa7OAlijm+C4b5aX5l45IW4ZlnYUGUzys\n"\
        "jwIDAQAB\n"\
        "-----END PUBLIC KEY-----\n"

#define CLOUD_CA_CERTIFICATE \
        "-----BEGIN CERTIFICATE-----\n"\
        "MIIDQTCCAimgAwIBAgITBmyfz5m/jAo54vB4ikPmljZbyjANBgkqhkiG9w0BAQsF\n"\
        "ADA5MQswCQYDVQQGEwJVUzEPMA0GA1UEChMGQW1hem9uMRkwFwYDVQQDExBBbWF6\n"\
        "b24gUm9vdCBDQSAxMB4XDTE1MDUyNjAwMDAwMFoXDTM4MDExNzAwMDAwMFowOTEL\n"\
        "MAkGA1UEBhMCVVMxDzANBgNVBAoTBkFtYXpvbjEZMBcGA1UEAxMQQW1hem9uIFJv\n"\
        "b3QgQ0EgMTCCASIwDQYJKoZIhvcNAQEBBQADggEPADCCAQoCggEBALJ4gHHKeNXj\n"\
        "ca9HgFB0fW7Y14h29Jlo91ghYPl0hAEvrAIthtOgQ3pOsqTQNroBvo3bSMgHFzZM\n"\
        "9O6II8c+6zf1tRn4SWiw3te5djgdYZ6k/oI2peVKVuRF4fn9tBb6dNqcmzU5L/qw\n"\
        "IFAGbHrQgLKm+a/sRxmPUDgH3KKHOVj4utWp+UhnMJbulHheb4mjUcAwhmahRWa6\n"\
        "VOujw5H5SNz/0egwLX0tdHA114gk957EWW67c4cX8jJGKLhD+rcdqsq08p8kDi1L\n"\
        "93FcXmn/6pUCyziKrlA4b9v7LWIbxcceVOF34GfID5yHI9Y/QCB/IIDEgEw+OyQm\n"\
        "jgSubJrIqg0CAwEAAaNCMEAwDwYDVR0TAQH/BAUwAwEB/zAOBgNVHQ8BAf8EBAMC\n"\
        "AYYwHQYDVR0OBBYEFIQYzIU07LwMlJQuCFmcx7IQTgoIMA0GCSqGSIb3DQEBCwUA\n"\
        "A4IBAQCY8jdaQZChGsV2USggNiMOruYou6r4lK5IpDB/G/wkjUu0yKGX9rbxenDI\n"\
        "U5PMCCjjmCXPI6T53iHTfIUJrU6adTrCC2qJeHZERxhlbI1Bjjt/msv0tadQ1wUs\n"\
        "N+gDS63pYaACbvXy8MWy7Vu33PqUXHeeE6V/Uq2V8viTO96LXFvKWlJbYK8U90vv\n"\
        "o/ufQJVtMVT8QtPHRh8jrdkPSHCa2XV4cdFyQzR1bldZwgJcJmApzyMZFo6IQ6XU\n"\
        "5MsI+yMRQ+hDKXJioaldXgjUkK642M4UwtBV8ob2xJNDd2ZhwLnoQdeXeGADbkpy\n"\
        "rqXRfboQnoZsG4q5WTP468SQvvG5\n"\
        "-----END CERTIFICATE-----\n"
```
